## config/boards/shields/reviung36/Kconfig.defconfig
```kconfig
# Copyright (c) 2020 The ZMK Contributors
# SPDX-License-Identifier: MIT

if SHIELD_REVIUNG36

config ZMK_KEYBOARD_NAME
    default "reviung36"

config ZMK_POINTING
    default y

config SPI
    default y

endif
```

## config/boards/shields/reviung36/Kconfig.shield
```kconfig
# Copyright (c) 2020 The ZMK Contributors
# SPDX-License-Identifier: MIT

config SHIELD_REVIUNG36
    def_bool $(shields_list_contains,reviung36)
```
